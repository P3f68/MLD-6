## meta-mld-source/conf/distro/MLD.conf
```bitbake
DISTRO = "MLD"
DISTRO_NAME = "MLD"
DISTRO_VERSION = "6.0"

hostname_pn-base-files = "mld"

MAINTAINER = "Claus Muus <mld@clausmuus.de>"

TARGET_VENDOR = "-mld"

LOCALCONF_VERSION = "1"


MLD_DEFAULT_DISTRO_FEATURES = "largefile opengl ptest multiarch wayland"
MLD_DEFAULT_EXTRA_RDEPENDS = "packagegroup-core-boot"
MLD_DEFAULT_EXTRA_RRECOMMENDS = "kernel-module-af-packet"

DISTRO_FEATURES ?= "${DISTRO_FEATURES_DEFAULT} ${DISTRO_FEATURES_LIBC} ${MLD_DEFAULT_DISTRO_FEATURES}"

PREFERRED_PROVIDER_udev = "udev"
PREFERRED_PROVIDER_jpeg = "jpeg"
PREFERRED_PROVIDER_jpeg-native = "jpeg-native"

DISTRO_VERSION[vardepsexclude] = "DATE"
SDK_VERSION[vardepsexclude] = "DATE"
DISTRO_EXTRA_RDEPENDS += " ${MLD_DEFAULT_EXTRA_RDEPENDS}"
DISTRO_EXTRA_RRECOMMENDS += " ${MLD_DEFAULT_EXTRA_RRECOMMENDS}"

INHERIT += "blacklist"
require conf/distro/recipe-blacklist-mld.inc

SANITY_TESTED_DISTROS ?= " \
            debian GNU/Linux 8 (jessie) \n \
            poky-2.4 \n \
            poky-2.5 \n \
            ubuntu-15.04 \n \
            ubuntu-16.04 \n \
            ubuntu-16.10 \n \
            ubuntu-17.04 \n \
            fedora-26 \n \
            centos-7 \n \
            debian-8 \n \
            debian-9 \n \
            opensuse-42.1 \n \
            opensuse-42.2 \n \
	    "


# Default hash policy for distro
BB_SIGNATURE_HANDLER ?= 'OEBasicHash'
#
# OELAYOUT_ABI allows us to notify users when the format of TMPDIR changes in 
# an incompatible way. Such changes should usually be detailed in the commit
# that breaks the format and have been previously discussed on the mailing list 
# with general agreement from the core team.
#
OELAYOUT_ABI = "8"

#INITRAMFS_FSTYPES = "cpio.gz"
#INITRAMFS_IMAGE = "MLD-initramfs-${DATE}"
INITRAMFS_IMAGE = "MLD-initramfs" 
INITRAMFS_IMAGE_BUNDLE = "1"

IMAGE_FSTYPES = "iso"
```
